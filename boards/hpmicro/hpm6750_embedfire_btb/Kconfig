## boards/hpmicro/hpm6750_embedfire_btb/Kconfig
```kconfig
# SPDX-License-Identifier: Apache-2.0

if BOARD_HPM6750_EMBEDFIRE_BTB

config INIT_EXT_RAM
	bool "Initialize the board SDRAM"
	default y
	select HAS_HPMSDK_FEMC

endif
```

## boards/hpmicro/hpm6750_embedfire_btb/Kconfig.hpm6750_embedfire_btb
```kconfig
# SPDX-License-Identifier: Apache-2.0

config BOARD_HPM6750_EMBEDFIRE_BTB
	select SOC_HPM6750
```

## boards/hpmicro/hpm6750_embedfire_btb/board.yml
```yaml
board:
  name: hpm6750_embedfire_btb
  vendor: hpmicro
  socs:
    - name: hpm6750
```

## west.yml
```yaml
manifest:
  version: "1.0"

  projects:
    - name: sdk_glue
      url: https://github.com/sendu2wfdx/zephyr-hpmicro-glue.git
      revision: de0f4fdf71871dfe72eb8874332dcf4d9266ceb9
      import: true

  self:
    path: zephyr-embedfire-hpm6750
```

## zephyr/Kconfig
```kconfig
# SPDX-License-Identifier: Apache-2.0

config EBF_HPM6750_PWM1_HEADER
	bool "EmbedFire HPM6750 internal PWM1 header route marker"
	default n

config EBF_HPM6750_SPI2_HEADER
	bool "EmbedFire HPM6750 internal SPI2 header route marker"
	default n

config EBF_HPM6750_CAN1_PB_HEADER
	bool "EmbedFire HPM6750 internal CAN1 PB route marker"
	default n

config EBF_HPM6750_CAN2_ONBOARD
	bool "EmbedFire HPM6750 internal onboard CAN2 route marker"
	default n

config EBF_HPM6750_CAN2_HEADER
	bool "EmbedFire HPM6750 internal header CAN2 route marker"
	default n
```
